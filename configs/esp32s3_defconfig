## configs/esp32s3_defconfig
```kconfig
BR2_xtensa=y
BR2_XTENSA_DYNCONFIG=y
BR2_TOOLCHAIN_EXTERNAL=y
BR2_TOOLCHAIN_EXTERNAL_PATH="/home/jcmvbkbc/ws/tensilica/uclibc/build-xtensa-fdpic-toolchain-esp32s3/root"
BR2_TOOLCHAIN_EXTERNAL_CUSTOM_PREFIX="$(ARCH)-linux-uclibcfdpic"
BR2_TOOLCHAIN_EXTERNAL_HEADERS_6_1=y
# BR2_TOOLCHAIN_EXTERNAL_HAS_THREADS is not set
BR2_LINUX_KERNEL=y
BR2_LINUX_KERNEL_CUSTOM_GIT=y
BR2_LINUX_KERNEL_CUSTOM_REPO_URL="https://github.com/jcmvbkbc/linux-xtensa.git"
BR2_LINUX_KERNEL_CUSTOM_REPO_VERSION="xtensa-6.4-esp32"
BR2_LINUX_KERNEL_USE_CUSTOM_CONFIG=y
BR2_LINUX_KERNEL_CUSTOM_CONFIG_FILE="board/espressif/esp32s3/linux.config"
BR2_LINUX_KERNEL_IMAGE_TARGET_CUSTOM=y
BR2_LINUX_KERNEL_IMAGE_TARGET_NAME="xipImage"
BR2_PACKAGE_BUSYBOX_CONFIG="board/espressif/esp32s3/busybox.config"
BR2_TARGET_ROOTFS_CRAMFS=y
BR2_TARGET_ROOTFS_CRAMFS_XIP=y
```

## configs/qemu_xtensa_nommu_de212_defconfig
```kconfig
BR2_xtensa=y
BR2_XTENSA_CUSTOM=y
BR2_XTENSA_CUSTOM_NAME="de212"
BR2_XTENSA_OVERLAY_DIR="board/qemu/xtensa-nommu-de212"
BR2_ENABLE_DEBUG=y
BR2_KERNEL_HEADERS_4_1=y
BR2_UCLIBC_VERSION_XTENSA_GIT=y
BR2_UCLIBC_CONFIG="package/uclibc/uClibc-ng.config"
BR2_TOOLCHAIN_BUILDROOT_INET_RPC=y
BR2_TOOLCHAIN_BUILDROOT_WCHAR=y
BR2_BINUTILS_VERSION_2_25_X=y
BR2_GCC_VERSION_5_X=y
BR2_PACKAGE_HOST_ELF2FLT=y
# BR2_USE_MMU is not set
BR2_PACKAGE_BUSYBOX_CONFIG="package/busybox/busybox-nommu.config"
BR2_PACKAGE_STRACE=y
BR2_PACKAGE_DROPBEAR=y
BR2_PACKAGE_ETHTOOL=y
BR2_TARGET_ROOTFS_CPIO=y
```

## configs/xtsc_mw_mp_xrp_defconfig
```kconfig
BR2_xtensa=y
BR2_XTENSA_CUSTOM=y
BR2_XTENSA_CUSTOM_NAME="dc233c"
BR2_XTENSA_OVERLAY_DIR="board/xtsc/mw-mp"
BR2_KERNEL_HEADERS_4_8=y
BR2_TOOLCHAIN_BUILDROOT_INET_RPC=y
BR2_TOOLCHAIN_BUILDROOT_WCHAR=y
BR2_PTHREAD_DEBUG=y
BR2_LINUX_KERNEL=y
BR2_LINUX_KERNEL_CUSTOM_GIT=y
BR2_LINUX_KERNEL_CUSTOM_REPO_URL="git://github.com/jcmvbkbc/linux-xtensa.git"
BR2_LINUX_KERNEL_CUSTOM_REPO_VERSION="xtensa-xrp"
BR2_LINUX_KERNEL_DEFCONFIG="xrp"
BR2_LINUX_KERNEL_IMAGE_TARGET_CUSTOM=y
BR2_LINUX_KERNEL_IMAGE_TARGET_NAME="zImage"
BR2_LINUX_KERNEL_IMAGE_NAME="Image.elf"
BR2_PACKAGE_XRP=y
BR2_PACKAGE_XRP_FIRMWARE=y
BR2_PACKAGE_XRP_FIRMWARE_XTENSA_TOOLS="/opt/xtensa/XtDevTools/install/tools/RG-2016.3-linux/XtensaTools/bin"
BR2_PACKAGE_XRP_FIRMWARE_DSP_LSP="$(TOPDIR)/board/xtsc/mw-mp/lsp/P6_%d/xtensa-elf/lib/sim-stacklocal"
BR2_TARGET_ROOTFS_EXT2=y
BR2_TARGET_ROOTFS_EXT2_4=y
# BR2_TARGET_ROOTFS_TAR is not set
BR2_PACKAGE_HOST_E2TOOLS=y
```

## configs/xtsc_xvp_p5_defconfig
```kconfig
BR2_xtensa=y
BR2_XTENSA_CUSTOM=y
BR2_XTENSA_CUSTOM_NAME="dc233c"
BR2_XTENSA_OVERLAY_DIR="board/xtsc/xvp-p5"
BR2_KERNEL_HEADERS_4_8=y
BR2_TOOLCHAIN_BUILDROOT_INET_RPC=y
BR2_TOOLCHAIN_BUILDROOT_WCHAR=y
BR2_PTHREAD_DEBUG=y
BR2_TOOLCHAIN_BUILDROOT_CXX=y
BR2_PACKAGE_HOST_GDB=y
BR2_LINUX_KERNEL=y
BR2_LINUX_KERNEL_CUSTOM_GIT=y
BR2_LINUX_KERNEL_CUSTOM_REPO_URL="git://github.com/jcmvbkbc/linux-xtensa.git"
BR2_LINUX_KERNEL_CUSTOM_REPO_VERSION="xtensa-xvp-apk4.0"
BR2_LINUX_KERNEL_DEFCONFIG="xvp"
BR2_LINUX_KERNEL_IMAGE_TARGET_CUSTOM=y
BR2_LINUX_KERNEL_IMAGE_TARGET_NAME="zImage"
BR2_LINUX_KERNEL_IMAGE_NAME="Image.elf"
BR2_PACKAGE_GDB=y
BR2_PACKAGE_GDB_SERVER=y
BR2_PACKAGE_GDB_DEBUGGER=y
BR2_PACKAGE_STRACE=y
BR2_TARGET_ROOTFS_EXT2=y
BR2_TARGET_ROOTFS_EXT2_4=y
BR2_TARGET_ROOTFS_EXT2_BLOCKS=131072
# BR2_TARGET_ROOTFS_TAR is not set
BR2_PACKAGE_HOST_E2TOOLS=y
```

## package/xrp/Config.in
```kconfig
comment "Xtensa Remote Processing needs a Linux kernel to be built"
	depends on !BR2_LINUX_KERNEL

config BR2_PACKAGE_XRP
	bool "XRP"
	depends on BR2_LINUX_KERNEL
	help
	  XRP is the low level Xtensa Remote Processing

if BR2_PACKAGE_XRP

config BR2_PACKAGE_XRP_SOURCE_TREE
	string "XRP source tree location"
	help
	  Location of XRP git tree

config BR2_PACKAGE_XRP_XTENSA_TOOLS
	string "Xtensa tools location"
	help
	  Xtensa tools location

config BR2_PACKAGE_XRP_XTENSA_NEED_SYSTEM
	bool "Separate Xtensa core registry location"
	default n
	help
	  Whether tools know where their core registry is or not (and so
	  need --xtensa-system= parameter).

config BR2_PACKAGE_XRP_XTENSA_SYSTEM
	string "Xtensa core registry location"
	depends on BR2_PACKAGE_XRP_XTENSA_NEED_SYSTEM
	help
	  Xtensa core registry location

endif
```

## package/xrp/Config.in.host
```kconfig
config BR2_PACKAGE_HOST_XRP
	bool "host XRP (fast simulation)"
	help
	  XRP is the low level Xtensa Remote Processing

config BR2_PACKAGE_HOST_XRP_EXAMPLE
	bool "Build XRP example"
	depends on BR2_PACKAGE_HOST_XRP
	default y
	help
	  XRP package contains fast simulation userspace library and example
	  code and firmware library and example code.
	  Say 'Y' here to build example userspace code for fast simulation.

config BR2_PACKAGE_HOST_XRP_FIRMWARE
	bool "host XRP firmware (fast simulation)"
	help
	  XRP package contains fast simulation userspace library and example
	  code and firmware library and example code.
	  Say 'Y' here to build firmware library for fast simulation mode.

if BR2_PACKAGE_HOST_XRP_FIRMWARE

config BR2_PACKAGE_HOST_XRP_FIRMWARE_XTENSA_TOOLS
	string "Xtensa tools location"
	help
	  Xtensa tools location

config BR2_PACKAGE_HOST_XRP_FIRMWARE_XTENSA_NEED_SYSTEM
	bool "Separate Xtensa core registry location"
	help
	  Whether tools know where their core registry is or not (and so
	  need --xtensa-system= parameter).

config BR2_PACKAGE_HOST_XRP_FIRMWARE_XTENSA_SYSTEM
	string "Xtensa core registry location"
	depends on BR2_PACKAGE_HOST_XRP_FIRMWARE_XTENSA_NEED_SYSTEM
	help
	  Xtensa core registry location

config BR2_PACKAGE_HOST_XRP_FIRMWARE_DSP_CORE_NAME
	string "DSP core name"
	default visionp6cnn_ao_exls
	help
	  Xtensa core name used to build firmware.

config BR2_PACKAGE_HOST_XRP_FIRMWARE_EXAMPLE
	bool "Build XRP firmware example"
	default y
	help
	  XRP package contains fast simulation userspace library and example
	  code and firmware library and example code.
	  Say 'Y' here to build example firmware for fast simulation mode.

if BR2_PACKAGE_HOST_XRP_FIRMWARE_EXAMPLE

config BR2_PACKAGE_HOST_XRP_FIRMWARE_DSP_NUM_CORES
	int "Number of DSP cores"
	default 2
	help
	  Number of DSP cores served by the XRP driver. A firmware image
	  is built for each controlled DSP core.

config BR2_PACKAGE_HOST_XRP_FIRMWARE_DSP_LSP
	string "LSP name for each core"
	default "MW-MP/P6_%d/xtensa-elf/lib/sim-stacklocal"
	help
	  Printf format string for LSP name for each core. May use %d or
	  similar format placeholder.

config BR2_PACKAGE_HOST_XRP_FIRMWARE_DSP_COMM_BASE
	string "Communication area address for each core"
	help
	  Space-separated list of communication area physical addresses
	  for each core.

endif
endif
```
